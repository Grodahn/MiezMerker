## firmware-esp32/idf/main/Kconfig.projbuild
```kconfig
menu "MiezMerker board"
config MM_DEV_SYNTHETIC_INPUT
    bool "Enable bounded synthetic RFID commands on the USB console"
    default n
    help
        Development only. Commands use the real Core capture and NVS path.
        Does not weaken authorization or expose a BLE injection endpoint.
config MM_DEV_GPIO_RFID
    bool "Enable development GPIO pushbutton RFID reader"
    default n
    help
        Explicit development build only. Active LOW with internal pull-up.
        Each debounced press offers one random demo chip 1..5 to the real Core.
        Requires CMake MM_DEVELOPMENT_BUILD=ON; release builds reject this flag.
config MM_DEV_GPIO_RFID_PIN
    int "Development RFID button GPIO"
    depends on MM_DEV_GPIO_RFID
    range 0 10
    default 3
    help
        SuperMini GPIO3 is unused. GPIO2/8/9 are forbidden strapping/BOOT pins.
        USB18/19 and flash pins are outside this range. Recheck wiring conflicts
        before selecting another pin or adding real reader/RTC hardware.
config MM_ISSUER_PUBLIC_KEY_HEX
    string "Independently pinned backend P-256 public key (130 hex characters)"
    default ""
    help
        Uncompressed 04 || x || y, obtained from the trusted deployment.
        Empty means fail closed for credentials and receipts. No private issuer key.
endmenu
```

## firmware-esp32/idf/sdkconfig.defaults
```kconfig
CONFIG_IDF_TARGET="esp32c3"
CONFIG_ESPTOOLPY_FLASHSIZE_4MB=y
CONFIG_PARTITION_TABLE_CUSTOM=y
CONFIG_PARTITION_TABLE_CUSTOM_FILENAME="partitions.csv"
CONFIG_ESP_CONSOLE_USB_SERIAL_JTAG=y
CONFIG_ESP_CONSOLE_SECONDARY_NONE=y
CONFIG_ESP_DEFAULT_CPU_FREQ_MHZ_160=y
CONFIG_BT_ENABLED=y
CONFIG_BT_NIMBLE_ENABLED=y
CONFIG_BT_NIMBLE_ROLE_CENTRAL=n
CONFIG_BT_NIMBLE_ROLE_OBSERVER=n
CONFIG_BT_NIMBLE_MAX_CONNECTIONS=1
CONFIG_BT_NIMBLE_ATT_PREFERRED_MTU=517
CONFIG_BT_NIMBLE_HOST_TASK_STACK_SIZE=8192
CONFIG_ESP_MAIN_TASK_STACK_SIZE=8192
CONFIG_COMPILER_CXX_EXCEPTIONS=y
CONFIG_COMPILER_OPTIMIZATION_SIZE=y
```
